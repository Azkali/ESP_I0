## main/Kconfig.projbuild
```kconfig
menu "A2DP Example Configuration"

choice A2DP_SINK_OUTPUT
    prompt "A2DP Sink Output"
    default A2DP_SINK_OUTPUT_EXTERNAL_I2S
    help
        Select to use Internal DAC or external I2S driver

config A2DP_SINK_OUTPUT_INTERNAL_DAC
    bool "Internal DAC"
    help
        Select this to use Internal DAC sink output

config A2DP_SINK_OUTPUT_EXTERNAL_I2S
    bool "External I2S Codec"
    help
        Select this to use External I2S sink output

endchoice

config I2S_LRCK_PIN
    int "I2S LRCK (WS) GPIO"
    default 22
    depends on A2DP_SINK_OUTPUT_EXTERNAL_I2S
    help
        GPIO number to use for I2S LRCK(WS) Driver.

config I2S_BCK_PIN
    int "I2S BCK GPIO"
    default 26
    depends on A2DP_SINK_OUTPUT_EXTERNAL_I2S
    help
        GPIO number to use for I2S BCK Driver.

config I2S_DATA_PIN
    int "I2S DATA GPIO"
    default 25
    depends on A2DP_SINK_OUTPUT_EXTERNAL_I2S
    help
        GPIO number to use for I2S Data Driver.

config BT_REMOTE_NAME
    string "BT remote device name"
	default "ESP-ADF-SPEAKER"
	help
		BT_REMOTE_NAME (Bluetooth device name) for the example to connect to.

endmenu

menu "TFT Display DEMO Configuration"

config SPIFFS_BASE_ADDR
    hex "SPIFFS Base address"
    range 100000 1FFE000
    default 180000
    help
	Starting address of the SPIFFS area in ESP32 Flash

config SPIFFS_SIZE
    int "SPIFFS Size in bytes"
    range 262144 2097152
    default 1048576

config SPIFFS_LOG_BLOCK_SIZE
    int "SPIFFS Logical block size"
    range 4098 65536
    default 8192

config SPIFFS_LOG_PAGE_SIZE
    int "SPIFFS Logical page size"
    range 256 2048
    default 256
    help
	Set it to the phisycal page size og the used SPI Flash chip.

config EXAMPLE_DISPLAY_TYPE
    int
    default 0 if EXAMPLE_DISPLAY_TYPE0
    default 1 if EXAMPLE_DISPLAY_TYPE1
    default 2 if EXAMPLE_DISPLAY_TYPE2
    default 3 if EXAMPLE_DISPLAY_TYPE3

    choice
        prompt "Select predefined display configuration"
        default EXAMPLE_DISPLAY_TYPE0
        help
            Select predefined display configuration
    
        config EXAMPLE_DISPLAY_TYPE0
            bool "None"
        config EXAMPLE_DISPLAY_TYPE1
            bool "ESP-WROVER-KIT Display"
        config EXAMPLE_DISPLAY_TYPE2
            bool "Adafruit TFT Feather display"
        config EXAMPLE_DISPLAY_TYPE3
            bool "M5Stack TFT display"
    endchoice

config EXAMPLE_USE_WIFI
    bool "Use wifi in TFT Demo"
    default n
    help
        If WiFi is used ntp server will be used to provide the exact time
        and file timestamps will be correct.

config WIFI_SSID
    string "WiFi SSID"
   	depends on EXAMPLE_USE_WIFI
    default "myssid"
    help
	SSID (network name) for the demo to connect to.

config WIFI_PASSWORD
    string "WiFi Password"
   	depends on EXAMPLE_USE_WIFI
    default "mypassword"
    help
	WiFi password (WPA or WPA2) for the demo to use.


endmenu
```
